## package/sysid101/Config.in
```kconfig
config BR2_PACKAGE_SYSID101
  bool "sysid101"
  select BR2_PACKAGE_GTKIOSTREAM
  help
    This is the sysid101 from flatmax.

    santos.baez.gabriel.elo@gmail.com
```

## package/testPackage/Config.in
```kconfig
config BR2_PACKAGE_TESTPACKAGE
  bool "testPackage"
  help
    This is a test package using some simple test program

    santos.baez.gabriel.elo@gmail.com
```

## package/usb-bridge/Config.in
```kconfig
config BR2_PACKAGE_USB_BRIDGE
  bool "usb-bridge"
  select USB_ETH
  help
    This package creates and configures a usb gadget 
    network and a bridge.

    santos.baez.gabriel.elo@gmail.com
```
